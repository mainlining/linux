## Documentation/devicetree/bindings/leds/awinic,aw21018.yaml
```yaml
# SPDX-License-Identifier: (GPL-2.0-only OR BSD-2-Clause)
%YAML 1.2
---
$id: http://devicetree.org/schemas/leds/awinic,aw21018.yaml#
$schema: http://devicetree.org/meta-schemas/core.yaml#

title: Awinic AW21018 LED driver

maintainers:
  - Vasiliy Doylov <neko@altlinux.org>

description: |
  The AW21018 is an I2C-controlled 18-channel (6 x RGB) LED driver with
  individually controlled outputs and 12-bit PWM brightness resolution.

properties:
  compatible:
    const: awinic,aw21018

  reg:
    maxItems: 1

  "#address-cells":
    const: 1

  "#size-cells":
    const: 0

  enable-gpios:
    maxItems: 1

  awinic,global-current:
    $ref: /schemas/types.yaml#/definitions/uint8
    description: |
      Value of the global current control register (GCCR), 0-255. It sets the
      maximum output current of all channels; the absolute current depends on
      the external resistor REXT and is 40 mA at the maximum setting.
      Individual channels are further scaled by the led-scale property.
      A raw register value is used instead of led-max-microamp because the
      chip documentation does not provide a conversion between the register
      value and the output current.

patternProperties:
  "^led@[0-9a-f]+$":
    type: object
    $ref: common.yaml#
    unevaluatedProperties: false

    properties:
      reg:
        minimum: 0
        maximum: 17

      led-scale:
        $ref: /schemas/types.yaml#/definitions/uint8
        default: 255
        description: |
          Per-channel current scale written to the SL register. Values 0-255
          scale the LED output of the channel on top of the global current,
          to account for hardware variations, 255 is full scale.
          Defaults to 255 (0xFF).

    required:
      - reg

allOf:
  - $ref: common.yaml#

required:
  - compatible
  - reg
  - "#address-cells"
  - "#size-cells"
  - awinic,global-current

additionalProperties: false

examples:
  - |
    #include <dt-bindings/gpio/gpio.h>
    #include <dt-bindings/leds/common.h>

    i2c {
        #address-cells = <1>;
        #size-cells = <0>;

        led-controller@20 {
            compatible = "awinic,aw21018";
            reg = <0x20>;
            #address-cells = <1>;
            #size-cells = <0>;
            enable-gpios = <&tlmm 20 GPIO_ACTIVE_HIGH>;
            awinic,global-current = /bits/ 8 <0x66>;

            led@0 {
                reg = <0x0>;
                color = <LED_COLOR_ID_RED>;
                function = LED_FUNCTION_STATUS;
                led-scale = /bits/ 8 <0xff>;
            };

            led@1 {
                reg = <0x1>;
                color = <LED_COLOR_ID_GREEN>;
                function = LED_FUNCTION_STATUS;
                led-scale = /bits/ 8 <0x80>;
            };

            led@2 {
                reg = <0x2>;
                color = <LED_COLOR_ID_BLUE>;
                function = LED_FUNCTION_STATUS;
                led-scale = /bits/ 8 <0x80>;
            };
        };
    };

...
```

## Documentation/devicetree/bindings/media/i2c/sony,imx471.yaml
```yaml
# SPDX-License-Identifier: (GPL-2.0-only OR BSD-2-Clause)
%YAML 1.2
---
$id: http://devicetree.org/schemas/media/i2c/sony,imx471.yaml#
$schema: http://devicetree.org/meta-schemas/core.yaml#

title: Sony IMX471 CMOS Image Sensor

maintainers:
  - Danila Tikhonov <danila@mainlining.org>

description: |-
  The Sony IMX471 is a diagonal 5.822 mm (Type 1/3.09) 16-megapixel
  back-illuminated stacked CMOS active pixel image sensor with a 4656 x 3496
  active pixel array and 1.0 um square pixels. It uses a Quad Bayer color filter
  array, is programmable through an I2C interface, and outputs image data
  through MIPI CSI-2.

allOf:
  - $ref: /schemas/media/video-interface-devices.yaml#

properties:
  compatible:
    const: sony,imx471

  reg:
    maxItems: 1

  clocks:
    description: External input clock (19.2 MHz)
    maxItems: 1

  vana-supply:
    description: Analog power supply (2.8 V)

  vdig-supply:
    description: Digital core power supply (1.05 V)

  vif-supply:
    description: I/O interface power supply (1.8 V)

  reset-gpios:
    description: Sensor reset (XCLR) GPIO
    maxItems: 1

  port:
    $ref: /schemas/graph.yaml#/$defs/port-base
    unevaluatedProperties: false

    properties:
      endpoint:
        $ref: /schemas/media/video-interfaces.yaml#
        unevaluatedProperties: false

        properties:
          data-lanes:
            items:
              - const: 1
              - const: 2
              - const: 3
              - const: 4

          link-frequencies:
            maxItems: 1
            items:
              const: 200000000

        required:
          - data-lanes
          - link-frequencies

    required:
      - endpoint

required:
  - compatible
  - reg
  - clocks
  - vana-supply
  - vdig-supply
  - vif-supply
  - port

unevaluatedProperties: false

examples:
  - |
    #include <dt-bindings/clock/qcom,camcc-sc7280.h>
    #include <dt-bindings/gpio/gpio.h>

    i2c {
        #address-cells = <1>;
        #size-cells = <0>;

        camf_imx471: camera@1a {
            compatible = "sony,imx471";
            reg = <0x1a>;

            vana-supply = <&vreg_camf_vana_2p8>;
            vdig-supply = <&vreg_camf_vdig_1p1>;
            vif-supply = <&vreg_cam_vio_1p8>;

            clocks = <&camcc CAM_CC_MCLK0_CLK>;
            assigned-clocks = <&camcc CAM_CC_MCLK0_CLK>;
            assigned-clock-rates = <19200000>;

            reset-gpios = <&tlmm 20 GPIO_ACTIVE_LOW>;
            pinctrl-0 = <&cam_mclk0_default>;
            pinctrl-names = "default";

            orientation = <0>;
            rotation = <270>;

            port {
                camera_imx471_ep: endpoint {
                    data-lanes = <1 2 3 4>;
                    link-frequencies = /bits/ 64 <200000000>;
                    remote-endpoint = <&csiphy0_ep>;
                };
            };
        };
    };
...
```

## Documentation/devicetree/bindings/sound/nxp,tfa98xx.yaml
```yaml
# SPDX-License-Identifier: (GPL-2.0-only)
%YAML 1.2
---
$id: http://devicetree.org/schemas/sound/nxp,tfa98xx.yaml#
$schema: http://devicetree.org/meta-schemas/core.yaml#

title: NXP/Goodix TFA98xx (TFA2) smart speaker amplifiers

maintainers:
  - David Heidelberg <david@ixit.cz>

description:
  The TFA98xx (TFA2) family are I2C-controlled class-D speaker amplifiers
  with an integrated CoolFlux DSP.

allOf:
  - $ref: dai-common.yaml#

properties:
  compatible:
    enum:
      - nxp,tfa9894

  reg:
    maxItems: 1

  reset-gpios:
    maxItems: 1

  '#sound-dai-cells':
    const: 0

required:
  - compatible
  - reg
  - '#sound-dai-cells'

unevaluatedProperties: false

examples:
  - |
    #include <dt-bindings/gpio/gpio.h>

    i2c {
        #address-cells = <1>;
        #size-cells = <0>;

        audio-codec@34 {
            compatible = "nxp,tfa9894";
            reg = <0x34>;
            reset-gpios = <&tlmm 69 GPIO_ACTIVE_HIGH>;
            #sound-dai-cells = <0>;
        };
    };
```
